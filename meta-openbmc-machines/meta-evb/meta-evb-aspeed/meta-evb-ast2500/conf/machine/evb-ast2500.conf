## meta-openbmc-machines/meta-evb/meta-evb-aspeed/meta-evb-ast2500/conf/machine/evb-ast2500.conf
```bitbake
KMACHINE = "aspeed"
KERNEL_DEVICETREE = "mlx-ast2500-bmc.dtb"

UBOOT_MACHINE = "mlnxast2500bmc_config"

require conf/machine/include/ast2500.inc
require conf/machine/include/obmc-bsp-common.inc
```
